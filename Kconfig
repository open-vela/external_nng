## Kconfig
```kconfig
#
# For a description of the syntax of this configuration file,
# see kconfig-language at https://www.kernel.org/doc/Documentation/kbuild/kconfig-language.txt
#

config NNG
	tristate "enable nng library"
	default n

if NNG

config NNG_DEFINES
	string "nng configuration"
	default "NNG_PLATFORM_POSIX NNG_PROTOCOL_REQREP NNG_PROTOCOL_PUBSUB NNG_TRANSPORT_INPROC"

config NNG_DEMO
	tristate "enable nng demo"
	default n

if NNG_DEMO

config NNG_DEMO_PROGNAME
	string "program name"
	default "nng_demo"

config NNG_DEMO_PRIORITY
	int "task priority"
	default 100

config NNG_DEMO_STACKSIZE
	int "stack size"
	default 2048

endif #NNG_DEMO

endif #NNG
```
